## kernel/amlogic/p212/drivers/amlogic/cpu_info/Kconfig
```kconfig
config	AMLOGIC_CPU_INFO
	boolean "Amlogic chipid"
	default n
	help
	  say y to enable Amlogic chipid driver.

config AMZN_CHIP_ID_FORMAT
        bool "Amazon-style SoC ID support"
        help
          Select Y here to generate SoC ID in Amazon format (64-bit)
```

## kernel/amlogic/p212/drivers/amlogic/cpufreq/Kconfig
```kconfig
menu  "Meson CPUFREQ support"

choice
	prompt "Meson CPU Freq driver"
	default AMLOGIC_MESON_CPUFREQ

config AMLOGIC_MESON_CPUFREQ
	bool "Meson CPU Frequency scaling support"
	help
	This adds the CPUFreq driver for Meson series CPU
config AMLOGIC_SCPI_CPUFREQ
	bool "Meson SCPI CPU Frequency scaling support"
	help
	This adds the CPUFreq driver for Meson series CPU
endchoice

config AMLOGIC_CPUFREQ_PERFBOOST
	bool "Performance Boost supporta"
	depends on AMLOGIC_SCPI_CPUFREQ
	help
	Add Performance Boost support for Meson series CPU
endmenu
```

## kernel/amlogic/p212/drivers/amlogic/input/saradc/Kconfig
```kconfig
#
# Input core configuration
#
config AM_SARADC
	bool "Meson SAR ADC support"
	default n
	help
	  Say Y here if you want to use the Meson SAR ADC.

config BTS_THERMISTOR
	bool "ntc bts thermistor"
	default n
	help
	  Say Y here if you want to use the external NTC BTS thermistor
```

## kernel/amlogic/p212/drivers/iio/temperature/Kconfig
```kconfig
#
# Temperature sensor drivers
#
menu "Temperature sensors"

config TMP006
	tristate "TMP006 infrared thermopile sensor"
	depends on I2C
	help
	  If you say yes here you get support for the Texas Instruments
	  TMP006 infrared thermopile sensor.

	  This driver can also be built as a module. If so, the module will
	  be called tmp006.

config TMP103
	bool "TMP103 temperature sensor"
	depends on I2C
	help
	  If you say yes here you get support for the Texas Instruments
	  TMP103 temperature sensor.

endmenu
```

## kernel/amlogic/p212/sound/soc/amzn-spi-pcm/Kconfig
```kconfig
menuconfig SND_AMZN_SPI_PCM
	bool "Amazon SPI connected ADCs"
	help
	  Say Y if you want to add support for codecs attached to
	  the SPI chip for Amazon voice feature
```
